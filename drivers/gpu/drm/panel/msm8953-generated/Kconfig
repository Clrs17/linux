## drivers/gpu/drm/panel/msm8953-generated/Kconfig
```kconfig
menu "MSM8953 panel drivers generated with linux-mdss-dsi-panel-driver-generator"
	depends on GPIOLIB && OF && REGULATOR
	depends on DRM_MIPI_DSI

config DRM_PANEL_MSM8953_GENERATED
	tristate "Select all generated MSM8953 panel drivers by default"

config DRM_PANEL_HUAWEI_BOE_OTM1906C_5P5_1080P_CMD
	tristate "Huawei BOE_OTM1906C_5P5_1080P_CMD"
	default DRM_PANEL_MSM8953_GENERATED

config DRM_PANEL_HUAWEI_BOE_TD4322_5P5_1080P_CMD
	tristate "Huawei BOE_TD4322_5P5_1080P_CMD"
	default DRM_PANEL_MSM8953_GENERATED

config DRM_PANEL_HUAWEI_BOE_TEST1906C_5P5_1080P_CMD
	tristate "Huawei BOE_TEST1906C_5P5_1080P_CMD"
	default DRM_PANEL_MSM8953_GENERATED

config DRM_PANEL_HUAWEI_CTC_NT35596S_5P5_1080P_VIDEO
	tristate "Huawei CTC_NT35596S_5P5_1080P_VIDEO"
	default DRM_PANEL_MSM8953_GENERATED

config DRM_PANEL_HUAWEI_CTC_OTM1906C_5P5_1080P_CMD
	tristate "Huawei CTC_OTM1906C_5P5_1080P_CMD"
	default DRM_PANEL_MSM8953_GENERATED

config DRM_PANEL_HUAWEI_JDI_R63452_5P5_1080P_CMD
	tristate "Huawei JDI_R63452_5P5_1080P_CMD"
	default DRM_PANEL_MSM8953_GENERATED

config DRM_PANEL_HUAWEI_TIANMA_FIC8736_5P5_1080P_CMD
	tristate "Huawei TIANMA_FIC8736_5P5_1080P_CMD"
	default DRM_PANEL_MSM8953_GENERATED

config DRM_PANEL_HUAWEI_TIANMA_FOCAL8716_5P5_1080P_VIDEO
	tristate "Huawei TIANMA_FOCAL8716_5P5_1080P_VIDEO"
	default DRM_PANEL_MSM8953_GENERATED

config DRM_PANEL_HUAWEI_TIANMA_OTM1906C_5P5_1080P_CMD
	tristate "Huawei TIANMA_OTM1906C_5P5_1080P_CMD"
	default DRM_PANEL_MSM8953_GENERATED

endmenu
```
